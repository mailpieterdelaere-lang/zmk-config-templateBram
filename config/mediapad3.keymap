/ {
    keymap {
        compatible = "zmk,keymap";

        default_layer {
            bindings = <
                &kp PLAY_PAUSE    // D2
                &kp MEDIA_PREV    // D4
                &kp MEDIA_NEXT    // D6
            >;
        };
    };
};

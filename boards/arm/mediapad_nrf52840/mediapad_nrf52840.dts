/dts-v1/;
#include <nordic/nrf52840.dtsi>

/ {
    model = "Mediapad nRF52840";
    compatible = "zmk,mediapad-nrf52840";
    chosen {
        zephyr,console = &uart0;
        zephyr,shell-uart = &uart0;
        zephyr,flash-controller = &flash_controller;
        zephyr,code-partition = &code_partition;
    };
};

/ {
    aliases {
        kbd0 = &gpio0;
    };
};

&gpio0 {
    status = "okay";
};

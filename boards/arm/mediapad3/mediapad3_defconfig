## boards/arm/mediapad3/mediapad3_defconfig
```kconfig
# Basic Board Info
CONFIG_BOARD="mediapad3"
CONFIG_SOC="nRF52840"

# Keymap
CONFIG_ZMK_KEYMAP=y

# USB
CONFIG_USB_DEVICE_STACK=y
CONFIG_USB_DEVICE_PRODUCT="MediaPad3"
CONFIG_USB_DEVICE_MANUFACTURER="Custom"
CONFIG_USB_DEVICE_VID=0xCafe
CONFIG_USB_DEVICE_PID=0xBabe
CONFIG_USB_DEVICE_HID=y
CONFIG_USB_DEVICE_HID_KEYBOARD=y

# Bluetooth (optional)
CONFIG_BT=y
CONFIG_BT_HCI=y
CONFIG_BT_DEVICE_NAME="MediaPad3"
CONFIG_BT_HIDS=y
CONFIG_BT_HIDS_DEVICE_NAME="MediaPad3"
CONFIG_BT_PERIPHERAL=y
CONFIG_BT_AUTO_START=y

# Logging (optional, useful for debugging)
CONFIG_LOG=y
CONFIG_LOG_DEFAULT_LEVEL=3

# Other peripherals (if needed)
CONFIG_GPIO=y
```

## config/west.yml
```yaml
manifest:
  version: "0.12"

  remotes:
    - name: zmk
      url-base: https://github.com/zmkfirmware

  projects:
    - name: zmk
      remote: zmk
      revision: main
      path: zmk

  self:
    path: .
```

## west.yml
```yaml
manifest:
  version: 0.1
  remotes:
    - name: zmk
      url: https://github.com/zmkfirmware/zmk.git
      fetch: true
  projects:
    - name: zmk
      revision: main
      path: zmk
```

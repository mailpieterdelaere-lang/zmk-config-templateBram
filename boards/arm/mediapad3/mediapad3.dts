/ {
    compatible = "zmk,keyboard";

    aliases {
        keyboard0 = &keyboard;
    };

    keyboard {
        compatible = "zmk,keyboard";
        label = "mediapad3";

        matrix {
            rows = <3>;
            columns = <1>;
            row-gpios = <&gpio0 2 GPIO_ACTIVE_LOW>,
                        <&gpio0 4 GPIO_ACTIVE_LOW>,
                        <&gpio0 6 GPIO_ACTIVE_LOW>;
        };
    };
};
